## Documentation/devicetree/bindings/leds/rt5058-fled.txt
```
RT5058 FLED Driver Device Tree Node Property
Author: Jeff Chang <jeff_chang@richtek.com>

- compatible(str):
	compatible = "richtek,rt5058-fled";

- rt,control_mode(u32):	Fled Control Mode
	rt,control_mode = <1>;	/* 0 : i2c contrl
				   1 : pin contrl */

- interrupt-parent:
	intrerrupt-parent = <&rt5058>;

- interrupts:	(index of interrupt)
	interrupts =	<64>, <65>, <67>, <70>, <71>, <72>,
		     	<73>, <74>, <75>, <76>, <77>;

- interrup-names:	(name of interrups)
	interrupt-names =	"FLED_STRBPIN",		// 64
			 	"FLED_TORPIN",		// 65
			  	"FLED_LVF",		// 67
				"FLED_LED2_SHORT",	// 70
				"FLED_LED1_SHORT",	// 71
				"FLED_LED2_STRB",	// 72
				"FLED_LED1_STRB",	// 73
				"FLED_LED2_STRB_TO",	// 74
				"FLED_LED1_STRB_TO",	// 75
				"FLED_LED2_TOR",	// 76
				"FLED_LED1_TOR";	// 77


- rt,torch_en(u32 array):	led selection in torch mode.
	rt,torch_en = <1 1>;	/* <0 0>: both disable,
							   <1 0>: led1 enable ,
							   <0 1>: led2 enable,
							   <1 1>: both enable */

- rt,flash_en(u32 array):	led selection in strobe mode.
	rt,flash_en = <1 1>;	/* <0 0>: both disable,
							   <1 0>: led1 enablee,
							   <0 1>: led2 enable,
							   <1 1>: both enable */

EX:
	rt5058-fled {
		compatible = "richtek,rt5058-fled";
		rt,control_mode = <1>; /* 0:i2c control, 1:pin control */
		interrupt-parent = <&rt5058>;
		interrupts =	<64>, <65>, <67>, <70>, <71>, <72>,
			     	<73>, <74>, <75>, <76>, <77>;
		interrupt-names =	"FLED_STRBPIN",		// 64
				 	"FLED_TORPIN",		// 65
				  	"FLED_LVF",		// 67
					"FLED_LED2_SHORT",	// 70
					"FLED_LED1_SHORT",	// 71
					"FLED_LED2_STRB",	// 72
					"FLED_LED1_STRB",	// 73
					"FLED_LED2_STRB_TO",	// 74
					"FLED_LED1_STRB_TO",	// 75
					"FLED_LED2_TOR",	// 76
					"FLED_LED1_TOR";	// 77
		rt,torch_en = <1 1>;
		rt,flash_en = <1 1>;
	};
```

## Documentation/devicetree/bindings/mfd/rt5058-i2c.txt
```
RT5058 I2C Device Driver Device Tree Node Property
Author: Jeff Chang <jeff_chang@richtek.com>

- compatible:
	compatible = "richtek,rt5058";

- reg: slave address:
	reg = <0x34>;

- interrupt-controller:
	interrupt-controller;

- #interrups-cells:
	#interrupt-cells = <1>;

- rt,irq_pin:	GPIO Pin for RT5058 interrupts
	rt,irq_pin = <&msmgpio 59 0x00>;

- rt,i2cstmr_rsttmr(u32):	I2C Safe Timer for SDA/SCL low active
	rt,i2cstmr_rsttmr = <0>;	/* 0: 0.5sec, 1: 0.75sec, 2: 1sec, 3: 2sec */

- rt,batt_devname: battery name for communation. /* defualt is battery */
	rt,batt_devname = "battery";

- rt,chg_devname: charger name for communation.	/* default is rt5058-charger */
	rt,chg_devname = "rt5058-charger";

- rt,feul_devname: fuel-gauge name for communation. /* default is rt5058-fuelgauge */
	rt,fuel_devname = "rt5058-fuelgauge";

- rt,ac_devname: AC name for communation. /* default is ac */
	rt,ac_devname = "ac";

- rt,usb_devname: USB name for communation. /* default is usb */
	rt,usb_devname = "usb";

- rt5058-muic:		RT5058 MUIC Device Node
	rt5058-muic {
	};

- rt5058-charger:	RT5058 CHARGER Device Node
	rt5058-charger {
	};

- rt5058-fled:		RT5058 FLED Device Node
	rt5058-fled {
	};

- rt5058_buck1: regulator_0: RT5058 REGULATOR Device Node
	rt5058_buck1: regulator_0 {
	};
	rt5058_ldo1: regulator_1 {
	};
	rt5058_ldo2: regulator_2 {
	};
	rt5058_ldo3: regulator_3 {
	};
	rt5058_sldo1: regulator_4 {
	};
	rt5058_sldo2: regulator_5 {
	};

- rt5058-fuelgauge:	RT5058 FUELGAUGE Device Node
	rt5058-fuelgauge {
	};


EX:
i2c@f9967000 {
	status = "ok";

	rt5058: rt5058@34 {
		compatible = "richtek,rt5058";
		reg = <0x34>;
		interrupt-controller;
		#interrupt-cells = <1>;
		rt,irq_pin = <&msm_gpio 20 0>;
		rt,i2cstmr_rsttmr = <0>; /* 0: 0.5 sec, 1: 0.75 sec, 2: 1 sec, 3: 2 sec */
		rt,batt_devname = "battery";
		rt,ac_devname = "ac";
		rt,usb_devname = "usb";

		rt5058-charger {
			compatible = "richtek,rt5058-charger";
			rt,charger-name = "rt5058-charger";
			rt,use_te;
			//rt,use_batdet;
			rt,use_iinmeas;
			rt,use_mivr;
			rt,mivr = <4400>;
			rt,chg_iin_vth = <4800>;
			rt,use_aicr;
			rt,usb_aicr = <1400>;
			rt,usb_icc = <1400>;
			rt,ac_aicr = <1400>;
			rt,ac_icc = <1400>;
			rt,chg_volt = <4350>;
			rt,bst_volt = <5000>;
			rt,ieoc = <50>; /* 0: Disable, 1~19: 50mA~500mA */
			rt,prechg_volt = <2800>;
			rt,prechg_curr = <150>;
			rt,use_lbp; /* with it: enable low battery protection,
						   without it:disable */
			rt,lbp_volt = <2800>;
			rt,backchg_time = <0>;
			rt,iinlmt_sel = <1>; /* 0:by chg_type,
									1:by aicr,
									2:MAX(aicr, chg_type),
									3:MIN(aicr, chg_type) */
			rt,sel_swfreq = <0>;
			rt,fixfreq = <0>;
			rt,fc_timer = <0>; /* 0~7: 4~16hr, 8:disable timer */
			rt,prc_timer = <0>; /* 0~2: 30,45,60 mins, 3:disable timer */
			rt,sys_minvolt = <1>; /* 0~3: 3.5V~3.8V */
			interrupt-parent = <&rt5058>;
			interrupts = <124>;
			interrupt-names = "CHG_IRQ";	// 124
			rt,chg_irq_mask = <0xf0 0x08 0xf0 0x1f 0xff>;
			rt,hocp = <0>; /* 0 is 2.5A, 1 is 3.5A */
			rt,temp_level = <(-40) 10 25 70>; // temperature levels for JEITA
			//rt,use_jeita;
		};
		rt5058-fled {
			compatible = "richtek,rt5058-fled";
			rt,control_mode = <1>; /* 0:i2c control, 1:pin control */
			interrupt-parent = <&rt5058>;
			interrupts = <125>;
			interrupt-names = "FLED_IRQ";
			rt,fled_irq_mask = <0x34 0xc0>;
			rt,torch_en = <1 1>;
			rt,flash_en = <1 1>;
		};
		rt5058_buck1: regulator_0 {
			compatible = "richtek,rt5058-buck1";
			interrupt-parent = <&rt5058>;
			interrupts = <126>;
			interrupt-names = "PMIC_IRQ";
			regulator-name = "rt5058-buck1";
			regulator-min-microvolt = <1000000>;
			regulator-max-microvolt = <3000000>;
			rt,allow_mode_mask;
		};
		rt5058_ldo1: regulator_1 {
			compatible = "richtek,rt5058-ldo1";
			regulator-name = "rt5058-ldo1";
			regulator-min-microvolt = <1200000>;
			regulator-max-microvolt = <3000000>;
			rt,allow_mode_mask;
		};
		rt5058_ldo2: regulator_2 {
			compatible = "richtek,rt5058-ldo2";
			regulator-name = "rt5058-ldo2";
			regulator-min-microvolt = <1200000>;
			regulator-max-microvolt = <3000000>;
			rt,allow_mode_mask;
		};
		rt5058_ldo3: regulator_3 {
			compatible = "richtek,rt5058-ldo3";
			regulator-name = "rt5058-ldo3";
			regulator-min-microvolt = <1200000>;
			regulator-max-microvolt = <3000000>;
			rt,allow_mode_mask;
		};
		rt5058_sldo1: regulator_4 {
			compatible = "richtek,rt5058-sldo1";
			interrupt-parent = <&rt5058>;
			regulator-min-microvolt = <3300000>;
			regulator-max-microvolt = <4950000>;
			rt,allow_mode_mask;
		};
		rt5058_sldo2: regulator_5 {
			compatible = "richtek,rt5058-sldo2";
			regulator-name = "rt5058-sldo2";
			regulator-min-microvolt = <3300000>;
			regulator-max-microvolt = <4950000>;
			rt,allow_mode_mask;
		};

		rt5058-fuelgauge {
			compatible = "richtek,rt5058-fuelgauge";
			interrupt-parent = <&rt5058>;
			interrupts = <127>;
			interrupt-names = "FUEL_IRQ";
			rt,dtsi_version = <01 805>;
			rt,battery_type = <4350>; // 4200 4350 4400
			rt,temp_source_table = <0>;
			rt,wr_bc_en; // with it -> enable wr_bc, without it -> disable wr_bc
			rt,fg_oep_threshold = <0x210a>; // battery over energy protection
			rt,fg_otut_threshold = <0xff00>; // over/under temperature
			rt,fg_uv_threshold = <213>; // under voltage 0~5100mV(unit: 20mV)
			rt,fg_sc_step = <16>; // soc chagne alert step (unit 0.0625%)
			rt,fg_os_threshold = <0xffff>; // over soc
			rt,fg_us_threshold = <0x0000>; // under soc
			rt,fg_slpvol_threshold = <0x0096>; // sleep voltage
			rt,design_capacity = <2100>;
			rt,fg_op_config = <0x8200 0x0000 0x0000>;
			rt,fg_soc_config = <0x0110 0x0408>;
			rt,fg_irq_mask = <0xde7f 0xffff>;
			rt,fg_voltage_calibration = <0x0000>;
			rt,fg_current_calibration = <0x8080>;
			rt,cyc_adj_th = <100>;
			rt,cyc_adj_rat = <0>;
			rt,fg_aging_factor = <0x0032>;
			rt,fg_deadband = <0x0606>;
			rt,fg_comp_interpolation_order = <1 1 1>;
			rt,fg_comp_size = <1 3 1>;
			rt,fg_comp_data = <3200 0    1000 40 25 25 57 128 256 32100 0 2100
					   3200 150  1000 35 60 25 255 128 256 32100 0 2100
					   3200 400  1000 55 75 105 155 128 256 32100 0 2100>;
			rt,offset_interpolation_order = <2 2>;
			rt,soc_offset_size = <6 1>;
			rt,soc_offset_data = <0    250 0
							      15   250 0
							      19   250 0
							      20   250 0
							      100  250 0
							      1000 250 0>;
			rt,fg_function_table = <0 0x0 0x0 0x0 0x0 0x0 0x0 0x0 0x0
						0 0x0 0x0 0x0 0x0 0x0 0x0 0x0 0x0
						0 0x0 0x0 0x0 0x0 0x0 0x0 0x0 0x0
						0 0x0 0x0 0x0 0x0 0x0 0x0 0x0 0x0
						0 0x0 0x0 0x0 0x0 0x0 0x0 0x0 0x0>;
			rt,fg_soc_table = <0x0 0x0 0x0 0x0 0x0 0x0 0x0 0x0
					0x0 0x0 0x0 0x0 0x0 0x0 0x0 0x0
					0x0 0x0 0x0 0x0 0x0 0x0 0x0 0x0
					0x0 0x0 0x0 0x0 0x0 0x0 0x0 0x0
					0x0 0x0 0x0 0x0 0x0 0x0 0x0 0x0
					0x0 0x0 0x0 0x0 0x0 0x0 0x0 0x0
					0x0 0x0 0x0 0x0 0x0 0x0 0x0 0x0
					0x0 0x0 0x0 0x0 0x0 0x0 0x0 0x0
					0x0 0x0 0x0 0x0 0x0 0x0 0x0 0x0
					0x0 0x0 0x0 0x0 0x0 0x0 0x0 0x0>;
			rt,use_sc_count;
		};
	};
};
```

## Documentation/devicetree/bindings/power/rt-battery.txt
```
RT Battery Driver Device Tree Property

- compatible(str)
	compatible = "richtek,battery";

- rt,battery_name(str): name of battery power supply
	rt,battery_name = "lg-battery";

- rt,fuel_name(str): name of fuelgauge power supply
	rt,fuel_name = "rt5058-fuelgauge";

- rt,chg_name(str): name of charger power supply
	rt,chg_name = "rt5058-charger";

- rt,ac_name(str): name of ac power supply
	rt,ac_name = "lg-ac";

- rt,usb_name(str): name of usb power supply
	rt,usb_name = "lg-usb";

- rt,max_voltage(u32): the max voltage of battery
	rt,max_voltage = <4400>;

- rt,min_voltage(u32):  the min voltage of battery
	rt,min_voltage = <3750>;


EX:
	battery {
		compatible = "richtek,battery";
		rt,battery_name = "battery";
		rt,fuel_name = "rt5058-fuelgauge";
		rt,chg_name = "rt5058-charger";
		rt,ac_name = "ac";
		rt,usb_name = "usb";
		rt,max_voltage = <4400>;
		rt,min_voltage = <3750>;
	};
```

## Documentation/devicetree/bindings/power/rt5058-charger.txt
```
RT5058 Charger Driver Device Tree Node Property.
Author: Jeff Chang <jeff_chang@richtek.com>


- compatible:
	compatible = "richtek,rt5058-charger";

- rt,charger-name(str): (charger name, please use rt5058-charger for charger name)
	rt,charger-name = "rt5058-charger";

- rt,use_te(bool): Enable/Disable TE function
	rt,use_te;

- rt,use_batdet(bool): Enable/Disable Battery Detection Function
	rt,use_batdet;

- rt,use_iinmeas(bool): IIN measurement mechanism (enable/disable)
	rt,use_iinmeas;

- rt,use_mivr(bool):	MIVR function (enable/disable)
	rt,use_mivr;

- rt,mivr(u32): MIVR
	rt,mivr = <4600>;

- rt,chg_iin_vth: IIN measurement Detection comparator threshold
	rt,chg_iin_vth = <4600>;	/* 4100~4600 */

- rt,use_aicr(bool):	AICR function (enable/disable)
	rt,use_aicr;

- rt,usb_aicr(u32): input current limit for USB
	rt,usb_aicr = <1000>;

- rt,usb_icc(u32): charging current for usb
	rt,usb_icc = <1000>;

- rt,ac_aicr(u32): input current limit for AC
	rt,ac_aicr = <1000>; /* mA */

- rt,ac_icc(u32): charging current for AC
	rt,ac_icc = <1000>; /* mA */

- rt,chg_volt(u32): charging voltage(CV)
	rt,chg_volt = <4400>; /* mV */

- rt,bst_volt(32): boost mode voltage
	rt,bst_volt = <5000>; /* mV */

- rt,ieoc(u32): End of Charge Current
	rt,ieoc = <250>; /* mA */

- rt,prechg_volt(u32): Pre-charge Thresholg Voltage
	rt,prechg_volt = <2800>; /* mV */

- rt,prechg_curr(u32): Pre-charge Current
	rt,prechg_curr = <150>; /* mV */

- rt,use_lbp(bool): Low Battery Protection (enable/disable)
	rt,use_lbp;

- rt,lbp_volt(u32): Low Battery Protection Voltage
	rt,lbp_volt = <2800>; /* mV */

- rt,backchg_time(u32): Background Charge Time after EOC occures.
	rt,backchg_tiem = <0>;	/* 0: 0mins, 1: 30mins, 2: 45mins, 3: 60mins */

- rt,iinlmt_sel(u32): Input Current Limet Selection.
	rt,iinlmt_sel = <1>;
	/* 0 : CHG_TYP results is applied and ignore AICR.
	   1 : AICR is applied and ignore CHG_TYP results.
	   2 : Input limit is set to the higher level of AICR and CHG_TYP result.
	   3 : Input limit is set to the lower level of AICR and CHG_TYP result. */

- rt,sel_swfreq(u32):  Charger Switching Frequency (Charger/OTG)
	rt,sel_swfreq = <0>; 	/* 0 : Charger switching frequency is 1.5MHz.
				   1 : Charger switching frequency is 0.75MHz . */

- rt,fixfreq(u32):	Charger switching frequency
	rt,fixfreq = <0>;	/* 0 : charger switching frequency is varied.
				   1 : charger switching frequency is fixed. */

- rt,fc_timer(u32): Fast Charge Timer
	rt,fc_timer = <0>;	/* 0~6 : 4hrs~16hrs, 7: Timer disable */

- rt,prc_timer(u32): Pre-Charge Timer
	rt,prc_timer = <0>;	/* 0: 30mins, 1: 45mins, 2: 60mins, 3:disable */

- rt,sys_minvolt(u32): System UV Protection.
	rt,sys_minvolt = <1>;	/* 0: 3.5V, 1: 3.6V, 2: 3.7V, 4: 3.8V */

- interrupt-parent:
	interrupt-parent = <&rt5502>;

- interrupts: (the index of interrups)
	interrupts = 	<24>, <25>, <26>, <27>, <32>, <33>, <34>, <36>, <37>,
			<38>, <39>, <40>, <41>, <42>, <43>, <53>, <54>, <55>;

- interrupt-names: (name of interrups)
	interrupt-names = 	"CHG_IIN_MEAS",	// 24
				"CHG_ICC_MEAS",	// 25
				"CHG_MIVR",	// 26
				"CHG_PWR_RDY",	// 27
				"CHG_BATABS",	// 32
				"CHG_SYSUV",	// 33
				"CHG_TMR",	// 34
				"CHG_BATOV",	// 36
				"CHG_BADADP",	// 37
				"CHG_RVP",	// 38
				"CHG_TSSHD",	// 39
				"CHG_TREG",	// 40
				"CHG_RCHG",	// 41
				"CHG_TERMTMR",	// 42
				"CHG_IEOC",	// 42
				"CHG_BSTLV",	// 53
				"CHG_BSTOL",	// 54
				"CHG_BSTOVP";	// 55
- rt,chg_irq_mask(u32): charger irq mask
	rt,chg_irq_mask = <0xf0 0x08 0xf0 0x1f 0xff>

- rt,hocp(u32) : charger The OCP
	-rt,hocp = <0>; /* 0 is 2.5A, 1 is 3.5A */

- rt,temp_level(u32): temperature level range
	rt,temp_level = <(-40) 10 25 70>; // temperature levels for JEITA

- rt,use_jeita(bool) : Enable/Disable JEITA function
	rt,use_jeita;

EX:
	rt5058-charger {
				compatible = "richtek,rt5058-charger";
				rt,charger-name = "rt5058-charger";
				rt,use_te;
				//rt,use_batdet;
				rt,use_iinmeas;
				rt,use_mivr;
				rt,mivr = <4400>;
				rt,chg_iin_vth = <4800>;
				rt,use_aicr;
				rt,usb_aicr = <1400>;
				rt,usb_icc = <1400>;
				rt,ac_aicr = <1400>;
				rt,ac_icc = <1400>;
				rt,chg_volt = <4350>;
				rt,bst_volt = <5000>;
				rt,ieoc = <50>; /* 0: Disable, 1~19: 50mA~500mA */
				rt,prechg_volt = <2800>;
				rt,prechg_curr = <150>;
				rt,use_lbp; /* with it: enable low battery protection,
							   without it:disable */
				rt,lbp_volt = <2800>;
				rt,backchg_time = <0>;
				rt,iinlmt_sel = <1>; /* 0:by chg_type,
							1:by aicr,
							2:MAX(aicr, chg_type),
							3:MIN(aicr, chg_type) */
				rt,sel_swfreq = <0>;
				rt,fixfreq = <0>;
				rt,fc_timer = <0>; /* 0~7: 4~16hr, 8:disable timer */
				rt,prc_timer = <0>; /* 0~2: 30,45,60 mins, 3:disable timer */
				rt,sys_minvolt = <1>; /* 0~3: 3.5V~3.8V */
				interrupt-parent = <&rt5058>;
				interrupts = <124>;
				interrupt-names = "CHG_IRQ";	// 124
				rt,chg_irq_mask = <0xf0 0x08 0xf0 0x1f 0xff>;
				rt,hocp = <0>; /* 0 is 2.5A, 1 is 3.5A */
				rt,temp_level = <(-40) 10 25 70>; // temperature levels for JEITA
				//rt,use_jeita;
			};
```
