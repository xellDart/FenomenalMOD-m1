/* Copyright (c) 2014-2015, The Linux Foundation. All rights reserved.
 *
 * This program is free software; you can redistribute it and/or modify
 * it under the terms of the GNU General Public License version 2 and
 * only version 2 as published by the Free Software Foundation.
 *
 * This program is distributed in the hope that it will be useful,
 * but WITHOUT ANY WARRANTY; without even the implied warranty of
 * MERCHANTABILITY or FITNESS FOR A PARTICULAR PURPOSE.  See the
 * GNU General Public License for more details.
 */

/*---------------------------------------------------------------------------
 * This file is autogenerated file using gcdb parser. Please do not edit it.
 * Update input XML file to add a new entry or update variable in this file
 * VERSION = "1.0"
 *---------------------------------------------------------------------------*/
&mdss_mdp {
	dsi_tcl_ili9806e_fwvga_video: qcom,mdss_dsi_tcl_ili9806e_fwvga_video_panel {
		qcom,cont-splash-enabled;
		qcom,mdss-dsi-panel-name = "tcl fwvga video mode dsi panel";
		qcom,mdss-dsi-panel-controller = <&mdss_dsi0>;
		qcom,mdss-dsi-panel-type = "dsi_video_mode";
		qcom,mdss-dsi-panel-destination = "display_1";
		qcom,mdss-dsi-panel-framerate = <60>;
		qcom,mdss-dsi-virtual-channel-id = <0>;
		qcom,mdss-dsi-stream = <0>;
		qcom,mdss-dsi-panel-width = <480>;
		qcom,mdss-dsi-panel-height = <854>;
		qcom,mdss-dsi-h-front-porch = <80>;
		qcom,mdss-dsi-h-back-porch = <60>;
		qcom,mdss-dsi-h-pulse-width = <20>;
		qcom,mdss-dsi-h-sync-skew = <0>;
		qcom,mdss-dsi-v-back-porch = <20>;
		qcom,mdss-dsi-v-front-porch = <20>;
		qcom,mdss-dsi-v-pulse-width = <6>;
		qcom,mdss-dsi-h-left-border = <0>;
		qcom,mdss-dsi-h-right-border = <0>;
		qcom,mdss-dsi-v-top-border = <0>;
		qcom,mdss-dsi-v-bottom-border = <0>;
		qcom,mdss-dsi-bpp = <24>;
		qcom,mdss-dsi-color-order = "rgb_swap_rgb";
		qcom,mdss-dsi-underflow-color = <0xff>;
		qcom,mdss-dsi-border-color = <0>;
		qcom,mdss-pan-physical-width-dimension = <55>;
		qcom,mdss-pan-physical-height-dimension = <99>;
		qcom,mdss-dsi-on-command = [
				39 01 00 00 00 00 06 FF FF 98 06 04 01
				39 01 00 00 00 00 02 08 10
				39 01 00 00 00 00 02 21 01
				39 01 00 00 00 00 02 30 01
				39 01 00 00 00 00 02 31 00
				39 01 00 00 00 00 02 40 11
				39 01 00 00 00 00 02 41 44
				39 01 00 00 00 00 02 42 02
				39 01 00 00 00 00 02 43 09
				39 01 00 00 00 00 02 44 06
				39 01 00 00 00 00 02 50 98
				39 01 00 00 00 00 02 51 98
				39 01 00 00 00 00 02 52 00
				39 01 00 00 00 00 02 53 2A
				39 01 00 00 00 00 02 57 50
				39 01 00 00 00 00 02 60 07
				39 01 00 00 00 00 02 61 00
				39 01 00 00 00 00 02 62 09
				39 01 00 00 00 00 02 63 00
				39 01 00 00 00 00 02 A0 00 // Gamma Settings
				39 01 00 00 00 00 02 A1 05
				39 01 00 00 00 00 02 A2 0F
				39 01 00 00 00 00 02 A3 12
				39 01 00 00 00 00 02 A4 0B
				39 01 00 00 00 00 02 A5 1E
				39 01 00 00 00 00 02 A6 0A
				39 01 00 00 00 00 02 A7 0A
				39 01 00 00 00 00 02 A8 05
				39 01 00 00 00 00 02 A9 0A
				39 01 00 00 00 00 02 AA 03
				39 01 00 00 00 00 02 AB 06
				39 01 00 00 00 00 02 AC 0E
				39 01 00 00 00 00 02 AD 2E
				39 01 00 00 00 00 02 AE 2A
				39 01 00 00 00 00 02 AF 20
				39 01 00 00 00 00 02 C0 00
				39 01 00 00 00 00 02 C1 05
				39 01 00 00 00 00 02 C2 0D
				39 01 00 00 00 00 02 C3 10
				39 01 00 00 00 00 02 C4 09
				39 01 00 00 00 00 02 C5 1A
				39 01 00 00 00 00 02 C6 0B
				39 01 00 00 00 00 02 C7 09
				39 01 00 00 00 00 02 C8 02
				39 01 00 00 00 00 02 C9 07
				39 01 00 00 00 00 02 CA 05
				39 01 00 00 00 00 02 CB 04
				39 01 00 00 00 00 02 CC 0B
				39 01 00 00 00 00 02 CD 2D
				39 01 00 00 00 00 02 CE 29
				39 01 00 00 00 00 02 CF 20

				39 01 00 00 00 00 06 FF FF 98 06 04 02 /* 3 gamma */
				39 01 00 00 00 00 02 40 01
				39 01 00 00 00 00 02 00 0F
				39 01 00 00 00 00 02 01 0F
				39 01 00 00 00 00 02 02 0F
				39 01 00 00 00 00 02 03 0F
				39 01 00 00 00 00 02 04 0F
				39 01 00 00 00 00 02 05 0F
				39 01 00 00 00 00 02 06 0F
				39 01 00 00 00 00 02 07 0F
				39 01 00 00 00 00 02 08 0F
				39 01 00 00 00 00 02 09 0F
				39 01 00 00 00 00 02 0A 0F
				39 01 00 00 00 00 02 0B 0F
				39 01 00 00 00 00 02 0C 0F
				39 01 00 00 00 00 02 0D 0F
				39 01 00 00 00 00 02 0E 0F
				39 01 00 00 00 00 02 0F 0F
				39 01 00 00 00 00 02 10 0F
				39 01 00 00 00 00 02 11 0F
				39 01 00 00 00 00 02 12 0F
				39 01 00 00 00 00 02 13 0F
				39 01 00 00 00 00 02 14 0F
				39 01 00 00 00 00 02 15 0F
				39 01 00 00 00 00 02 16 0F
				39 01 00 00 00 00 02 17 0F
				39 01 00 00 00 00 02 18 0F
				39 01 00 00 00 00 02 19 0F
				39 01 00 00 00 00 02 1A 0F
				39 01 00 00 00 00 02 1B 0F
				39 01 00 00 00 00 02 1C 0F
				39 01 00 00 00 00 02 1D 0F
				39 01 00 00 00 00 02 1E 0F
				39 01 00 00 00 00 02 1F 0F
				39 01 00 00 00 00 02 20 0F
				39 01 00 00 00 00 02 21 0F
				39 01 00 00 00 00 02 22 0F
				39 01 00 00 00 00 02 23 0F
				39 01 00 00 00 00 02 24 0F
				39 01 00 00 00 00 02 25 0F
				39 01 00 00 00 00 02 26 0F
				39 01 00 00 00 00 02 27 0F
				39 01 00 00 00 00 02 28 0F
				39 01 00 00 00 00 02 29 0F
				39 01 00 00 00 00 02 2A 0F
				39 01 00 00 00 00 02 2B 0F
				39 01 00 00 00 00 02 2C 0F
				39 01 00 00 00 00 02 2D 0F
				39 01 00 00 00 00 02 2E 0F
				39 01 00 00 00 00 02 2F 0F
				39 01 00 00 00 00 02 30 0F
				39 01 00 00 00 00 02 31 0F
				39 01 00 00 00 00 02 32 0F
				39 01 00 00 00 00 02 33 0F
				39 01 00 00 00 00 02 34 0F
				39 01 00 00 00 00 02 35 0F
				39 01 00 00 00 00 02 36 0F
				39 01 00 00 00 00 02 37 0F
				39 01 00 00 00 00 02 38 0F
				39 01 00 00 00 00 02 39 0F
				39 01 00 00 00 00 02 3A 0F
				39 01 00 00 00 00 02 3B 0F
				39 01 00 00 00 00 02 3C 0F
				39 01 00 00 00 00 02 3D 0F
				39 01 00 00 00 00 02 3E 0F
				39 01 00 00 00 00 02 3F 0F

				39 01 00 00 00 00 06 FF FF 98 06 04 03
				39 01 00 00 00 00 02 00 00
				39 01 00 00 00 00 02 01 00
				39 01 00 00 00 00 02 02 00
				39 01 00 00 00 00 02 03 00
				39 01 00 00 00 00 02 04 00
				39 01 00 00 00 00 02 05 00
				39 01 00 00 00 00 02 06 00
				39 01 00 00 00 00 02 07 00
				39 01 00 00 00 00 02 08 00
				39 01 00 00 00 00 02 09 00
				39 01 00 00 00 00 02 0A 00
				39 01 00 00 00 00 02 0B 00
				39 01 00 00 00 00 02 0C 00
				39 01 00 00 00 00 02 0D 00
				39 01 00 00 00 00 02 0E 00
				39 01 00 00 00 00 02 0F 00
				39 01 00 00 00 00 02 10 00
				39 01 00 00 00 00 02 11 00
				39 01 00 00 00 00 02 12 00
				39 01 00 00 00 00 02 13 00
				39 01 00 00 00 00 02 14 00
				39 01 00 00 00 00 02 15 00
				39 01 00 00 00 00 02 16 00
				39 01 00 00 00 00 02 17 00
				39 01 00 00 00 00 02 18 00
				39 01 00 00 00 00 02 19 00
				39 01 00 00 00 00 02 1A 00
				39 01 00 00 00 00 02 1B 00
				39 01 00 00 00 00 02 1C 00
				39 01 00 00 00 00 02 1D 00
				39 01 00 00 00 00 02 1E 00
				39 01 00 00 00 00 02 1F 00
				39 01 00 00 00 00 02 20 00
				39 01 00 00 00 00 02 21 00
				39 01 00 00 00 00 02 22 00
				39 01 00 00 00 00 02 23 00
				39 01 00 00 00 00 02 24 00
				39 01 00 00 00 00 02 25 00
				39 01 00 00 00 00 02 26 00
				39 01 00 00 00 00 02 27 00
				39 01 00 00 00 00 02 28 00
				39 01 00 00 00 00 02 29 00
				39 01 00 00 00 00 02 2A 00
				39 01 00 00 00 00 02 2B 00
				39 01 00 00 00 00 02 2C 00
				39 01 00 00 00 00 02 2D 00
				39 01 00 00 00 00 02 2E 00
				39 01 00 00 00 00 02 2F 00
				39 01 00 00 00 00 02 30 00
				39 01 00 00 00 00 02 31 00
				39 01 00 00 00 00 02 32 00
				39 01 00 00 00 00 02 33 00
				39 01 00 00 00 00 02 34 00
				39 01 00 00 00 00 02 35 00
				39 01 00 00 00 00 02 36 00
				39 01 00 00 00 00 02 37 00
				39 01 00 00 00 00 02 38 00
				39 01 00 00 00 00 02 39 00
				39 01 00 00 00 00 02 3A 00
				39 01 00 00 00 00 02 3B 00
				39 01 00 00 00 00 02 3C 00
				39 01 00 00 00 00 02 3D 00
				39 01 00 00 00 00 02 3E 00
				39 01 00 00 00 00 02 3F 00
				39 01 00 00 00 00 02 40 00
				39 01 00 00 00 00 02 41 00
				39 01 00 00 00 00 02 42 00
				39 01 00 00 00 00 02 43 00
				39 01 00 00 00 00 02 44 00
				39 01 00 00 00 00 02 45 00
				39 01 00 00 00 00 02 46 00
				39 01 00 00 00 00 02 47 00
				39 01 00 00 00 00 02 48 00
				39 01 00 00 00 00 02 49 00
				39 01 00 00 00 00 02 4A 00
				39 01 00 00 00 00 02 4B 00
				39 01 00 00 00 00 02 4C 00
				39 01 00 00 00 00 02 4D 00
				39 01 00 00 00 00 02 4E 00
				39 01 00 00 00 00 02 4F 00
				39 01 00 00 00 00 02 50 00
				39 01 00 00 00 00 02 51 00
				39 01 00 00 00 00 02 52 00
				39 01 00 00 00 00 02 53 00
				39 01 00 00 00 00 02 54 00
				39 01 00 00 00 00 02 55 00
				39 01 00 00 00 00 02 56 00
				39 01 00 00 00 00 02 57 00
				39 01 00 00 00 00 02 58 00
				39 01 00 00 00 00 02 59 00
				39 01 00 00 00 00 02 5A 00
				39 01 00 00 00 00 02 5B 00
				39 01 00 00 00 00 02 5C 00
				39 01 00 00 00 00 02 5D 00
				39 01 00 00 00 00 02 5E 00
				39 01 00 00 00 00 02 5F 00
				39 01 00 00 00 00 02 60 00
				39 01 00 00 00 00 02 61 00
				39 01 00 00 00 00 02 62 00
				39 01 00 00 00 00 02 63 00
				39 01 00 00 00 00 02 64 00
				39 01 00 00 00 00 02 65 00
				39 01 00 00 00 00 02 66 00
				39 01 00 00 00 00 02 67 00
				39 01 00 00 00 00 02 68 00
				39 01 00 00 00 00 02 69 00
				39 01 00 00 00 00 02 6A 00
				39 01 00 00 00 00 02 6B 00
				39 01 00 00 00 00 02 6C 00
				39 01 00 00 00 00 02 6D 00
				39 01 00 00 00 00 02 6E 00
				39 01 00 00 00 00 02 6F 00
				39 01 00 00 00 00 02 70 00
				39 01 00 00 00 00 02 71 00
				39 01 00 00 00 00 02 72 00
				39 01 00 00 00 00 02 73 00
				39 01 00 00 00 00 02 74 00
				39 01 00 00 00 00 02 75 00
				39 01 00 00 00 00 02 76 00
				39 01 00 00 00 00 02 77 00
				39 01 00 00 00 00 02 78 00
				39 01 00 00 00 00 02 79 00
				39 01 00 00 00 00 02 7A 00
				39 01 00 00 00 00 02 7B 00
				39 01 00 00 00 00 02 7C 00
				39 01 00 00 00 00 02 7D 00
				39 01 00 00 00 00 02 7E 00
				39 01 00 00 00 00 02 7F 00

				39 01 00 00 00 00 06 FF FF 98 06 04 06
				39 01 00 00 00 00 02 00 21
				39 01 00 00 00 00 02 01 06
				39 01 00 00 00 00 02 02 00
				39 01 00 00 00 00 02 03 01
				39 01 00 00 00 00 02 04 06
				39 01 00 00 00 00 02 05 06
				39 01 00 00 00 00 02 06 80
				39 01 00 00 00 00 02 07 02
				39 01 00 00 00 00 02 08 07
				39 01 00 00 00 00 02 09 90
				39 01 00 00 00 00 02 0A 01
				39 01 00 00 00 00 02 0B 06
				39 01 00 00 00 00 02 0C 16
				39 01 00 00 00 00 02 0D 16
				39 01 00 00 00 00 02 0E 00
				39 01 00 00 00 00 02 0F 00
				39 01 00 00 00 00 02 10 77
				39 01 00 00 00 00 02 11 F0
				39 01 00 00 00 00 02 12 00
				39 01 00 00 00 00 02 13 86
				39 01 00 00 00 00 02 14 85
				39 01 00 00 00 00 02 15 C0
				39 01 00 00 00 00 02 16 08
				39 01 00 00 00 00 02 17 00
				39 01 00 00 00 00 02 18 00
				39 01 00 00 00 00 02 19 00
				39 01 00 00 00 00 02 1A 00
				39 01 00 00 00 00 02 1B 00
				39 01 00 00 00 00 02 1C 00
				39 01 00 00 00 00 02 1D 00
				39 01 00 00 00 00 02 20 01
				39 01 00 00 00 00 02 21 23
				39 01 00 00 00 00 02 22 45
				39 01 00 00 00 00 02 23 67
				39 01 00 00 00 00 02 24 01
				39 01 00 00 00 00 02 25 23
				39 01 00 00 00 00 02 26 45
				39 01 00 00 00 00 02 27 67
				39 01 00 00 00 00 02 30 11
				39 01 00 00 00 00 02 31 22
				39 01 00 00 00 00 02 32 11
				39 01 00 00 00 00 02 33 00
				39 01 00 00 00 00 02 34 66
				39 01 00 00 00 00 02 35 88
				39 01 00 00 00 00 02 36 22
				39 01 00 00 00 00 02 37 22
				39 01 00 00 00 00 02 38 AA
				39 01 00 00 00 00 02 39 CC
				39 01 00 00 00 00 02 3A BB
				39 01 00 00 00 00 02 3B DD
				39 01 00 00 00 00 02 3C 22
				39 01 00 00 00 00 02 3D 22
				39 01 00 00 00 00 02 3E 22
				39 01 00 00 00 00 02 3F 22
				39 01 00 00 00 00 02 40 22
				39 01 00 00 00 00 02 52 10
				39 01 00 00 00 00 02 53 10
				39 01 00 00 00 00 06 FF FF 98 06 04 07
				39 01 00 00 00 00 02 17 22
				39 01 00 00 00 00 02 02 77
				39 01 00 00 00 00 02 E1 79
				39 01 00 00 00 00 06 FF FF 98 06 04 00
				39 01 00 00 00 00 02 35 00
				39 01 00 00 00 00 02 55 B0
				05 01 00 00 96 00 01 11
				05 01 00 00 32 00 01 29];
		qcom,mdss-dsi-off-command = [
			    39 01 00 00 01 00 06 FF FF 98 06 04 00
				05 01 00 00 32 00 01 28
				05 01 00 00 96 00 01 10]; // 120ms -> 150ms
		qcom,mdss-dsi-on-command-state = "dsi_lp_mode";
		qcom,mdss-dsi-off-command-state = "dsi_lp_mode";
		qcom,mdss-dsi-h-sync-pulse = <0>;
		qcom,mdss-dsi-traffic-mode = "non_burst_sync_event";
		qcom,mdss-dsi-lane-map = "lane_map_0123";
		qcom,mdss-dsi-bllp-eof-power-mode;
		qcom,mdss-dsi-bllp-power-mode;
		qcom,mdss-dsi-lane-0-state;
		qcom,mdss-dsi-lane-1-state;
		qcom,mdss-dsi-panel-timings = [7B 20 10 00 3E 40 16 22 15 03 04 00];
		qcom,mdss-dsi-t-clk-post = <0x04>;
		qcom,mdss-dsi-t-clk-pre = <0x1A>;
		qcom,mdss-dsi-bl-min-level = <1>;
		qcom,mdss-dsi-bl-max-level = <127>;
		qcom,mdss-dsi-bl-pmic-control-type = "bl_others";
		qcom,mdss-dsi-dma-trigger = "trigger_sw";
		qcom,mdss-dsi-mdp-trigger = "none";
		qcom,mdss-dsi-reset-sequence = <1 20>,<0 20>,<1 120>;
		qcom,mdss-dsi-post-init-delay = <4>;
	};
};
