&i2c_6 {
	rt4832@11 {
		compatible = "richtek,rt4832";
		status = "ok";
		reg = <0x11>;

		richtek,bl-en-gpio = <&msm_gpio 24 0x00>;

		backlight {
			compatible = "richtek,rt4832-backlight";
			bl-name = "rt4832";
			blmap_size = <256>;
			initial-brightness = <177>;
			blmap = <
				8 25 25 25 25 25 25 25 25 25 25 25 25 25 25 25
				25 25 26 26 26 26 27 27 27 28 28 29 31 33 34 35
				35 35 36 36 37 37 38 38 39 40 41 42 43 44 45 46
				47 49 50 51 52 53 54 54 55 56 57 60 58 58 60 62
				64 65 67 69 71 73 75 77 80 82 84 86 89 91 93 95
				97 100 102 104 107 109 112 114 117 119 122 124 126 129 132 134
				137 139 142 145 148 150 153 156 159 162 165 168 171 171 171 178
				183 186 190 194 197 201 205 210 214 218 222 226 231 235 239 244
				247 251 255 259 263 268 272 276 280 284 289 293 298 302 307 312
				317 322 326 331 336 342 347 352 357 362 367 372 377 382 382 382
				398 423 452 452 452 454 456 458 460 462 464 466 468 474 480 487
				493 500 506 512 519 525 531 538 544 551 557 564 571 577 584 591
				598 605 613 620 627 635 642 650 657 665 672 680 688 696 712 712
				712 718 733 746 754 763 771 780 789 797 806 815 823 832 841 849
				858 867 876 885 894 903 913 922 932 941 951 960 970 980 990 999
				1009 1019 1029 1040 1051 1061 1072 1083 1094 1105 1116 1127 1138 1149 1160 1173>;
		};

		led_flash0: flash {
			cell-index = <0>;
			compatible = "richtek,rt4832-flash";
			label = "rt4832-flash";
			qcom,flash-name	= "rt4832-flash";
			qcom,flash-type	= <1>;
		};
	};
};
